/* Copyright (c) 2013, LGE Electronics. All rights reserved.
 *
 * This program is free software; you can redistribute it and/or modify
 * it under the terms of the GNU General Public License version 2 and
 * only version 2 as published by the Free Software Foundation.
 *
 * This program is distributed in the hope that it will be useful,
 * but WITHOUT ANY WARRANTY; without even the implied warranty of
 * MERCHANTABILITY or FITNESS FOR A PARTICULAR PURPOSE.  See the
 * GNU General Public License for more details.
 */

&soc {
	i2c@f9927000 { /* BLSP1 QUP5 */
		atmel_t641@4a {									/*touch ic I2C bus adddress*/
			revision = "rev_a...";								/*board version */
			compatible = "atmel,t641";						/*dtsi name*/
			status = "ok";									/*OK-used*/
			reg = <0x4a>;									/*touch ic I2C bus adddress 0x4a -> @4a*/
			interrupt-parent = <&msmgpio>;
			interrupts = <17 0x2>;							/*interrupt pin number*/
			vdd_ana-supply = <0>;
			vcc_i2c-supply = <&pm8226_l28>;
			vcc_dig-supply = <0>;							/*because of  GPIO use*/
			atmel,ldo2-gpio = <&msmgpio 64 0x00>;	//GPIO[064] TOUCH_LDO2_EN
			atmel,ldo1-gpio = <&msmgpio 63 0x00>;	//GPIO[063] TOUCH_LDO1_EN
			atmel,reset-gpio = <&msmgpio 16 0x00>;
			atmel,irq-gpio = <&msmgpio 17 0x00>;
			atmel,numtouch = <10>;							/*multi-touch count*/
			atmel,irqflags = <0x00000002>;					/*interrup flag type*/
			atmel,t15_num_keys = <0>;
			atmel,fw_name = "atmel/E7_0_53.fw";
			atmel,panel_check = <0>;
			atmel,knock_on_type = <1>;
			atmel,auto_fw_update = <0>;
			atmel,global_access_pixel = <0>;
			atmel,use_mfts = <1>; // Enable for CoF type only
			atmel,lcd_x = <4095>;
			atmel,lcd_y = <4095>;
			atmel,butt_check_enable = <0>;
			atmel,ghost_detection_enable = <0>;
			atmel,ghost_detection_value = <10 10 100 25 250 10>;
		};
	};
};
